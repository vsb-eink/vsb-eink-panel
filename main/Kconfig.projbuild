## main/Kconfig.projbuild
```kconfig
menu "E-Ink Panel"
    config ESP_WIFI_SSID_FALLBACK
        string "WiFi SSID"
        default "TUONET-IOT"
        help
            Name of the WiFi network to connect to

    config ESP_WIFI_PASSWORD_FALLBACK
        string "WiFi Password"
        default "tuo12345"
        help
            Password of the WiFi network to connect to

    config VSB_EINK_WEBSOCKET_URL_FALLBACK
        string "Hamilton WebSocket Endpoint"
        default "wss://eink.proxy.lksv.cz"
        help
            URL of the VSB E-INK WebSocket endpoint
endmenu
```

## sdkconfig.defaults
```kconfig
CONFIG_SECURE_SIGNED_APPS_NO_SECURE_BOOT=y
CONFIG_SECURE_BOOT_SIGNING_KEY="certs/secure_boot_signing_key.pem"
# CONFIG_APP_COMPILE_TIME_DATE is not set
CONFIG_ESPTOOLPY_FLASHSIZE_4MB=y
CONFIG_PARTITION_TABLE_CUSTOM=y
CONFIG_COMPILER_OPTIMIZATION_PERF=y
CONFIG_COMPILER_CXX_EXCEPTIONS=y
CONFIG_ADC_SUPPRESS_DEPRECATE_WARN=y
# CONFIG_TWAI_ERRATA_FIX_BUS_OFF_REC is not set
# CONFIG_TWAI_ERRATA_FIX_TX_INTR_LOST is not set
# CONFIG_TWAI_ERRATA_FIX_RX_FRAME_INVALID is not set
# CONFIG_TWAI_ERRATA_FIX_RX_FIFO_CORRUPT is not set
# CONFIG_ESP_SLEEP_PSRAM_LEAKAGE_WORKAROUND is not set
# CONFIG_ESP_SLEEP_FLASH_LEAKAGE_WORKAROUND is not set
CONFIG_PERIPH_CTRL_FUNC_IN_IRAM=y
CONFIG_SPIRAM=y
CONFIG_ESP_DEFAULT_CPU_FREQ_MHZ_240=y
CONFIG_ESP_INT_WDT_TIMEOUT_MS=300
CONFIG_ESP_IPC_TASK_STACK_SIZE=1536
# CONFIG_ESP_WIFI_STA_DISCONNECTED_PM_ENABLE is not set
# CONFIG_ESP_WIFI_SOFTAP_SUPPORT is not set
CONFIG_HEAP_ABORT_WHEN_ALLOCATION_FAILS=y
CONFIG_MBEDTLS_CERTIFICATE_BUNDLE_DEFAULT_CMN=y
# CONFIG_ESP_PROTOCOMM_SUPPORT_SECURITY_VERSION_1 is not set
# CONFIG_ESP_PROTOCOMM_SUPPORT_SECURITY_VERSION_2 is not set
# CONFIG_WS_TRANSPORT is not set
# CONFIG_VFS_SUPPORT_IO is not set
CONFIG_WIFI_PROV_BLE_FORCE_ENCRYPTION=y
```
